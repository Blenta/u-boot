## configs/itop4412_defconfig
```kconfig
CONFIG_ARM=y
CONFIG_ARCH_CPU_INIT=y
CONFIG_ARCH_EXYNOS=y
CONFIG_ARCH_EXYNOS4=y
CONFIG_TARGET_ITOP4412=y

CONFIG_SKIP_LOWLEVEL_INIT=y
CONFIG_SPL_SKIP_LOWLEVEL_INIT=y

CONFIG_TEXT_BASE=0x43E00000
CONFIG_SYS_MALLOC_LEN=0x5004000
CONFIG_SYS_MALLOC_F_LEN=0x4000
CONFIG_SYS_L2CACHE_OFF=y
CONFIG_NR_DRAM_BANKS=4
CONFIG_ENV_SIZE=0x4000
CONFIG_ENV_OFFSET=0x88200
CONFIG_ENV_MMC_EMMC_HW_PARTITION=1
CONFIG_SUPPORT_EMMC_BOOT=y
CONFIG_DEFAULT_DEVICE_TREE="exynos4412-itop4412"
CONFIG_SYS_MONITOR_LEN=262144
CONFIG_SYS_LOAD_ADDR=0x43E00000
CONFIG_SYS_MEM_TOP_HIDE=0x00100000
CONFIG_SUPPORT_PASSING_ATAGS=y
CONFIG_SETUP_MEMORY_TAGS=y
CONFIG_CMDLINE_TAG=y
CONFIG_INITRD_TAG=y

CONFIG_SPL=y
CONFIG_SPL_DM=y
CONFIG_SPL_GPIO=y
CONFIG_SPL_SERIAL=y
CONFIG_SPL_TEXT_BASE=0x02023400
CONFIG_SPL_LIBCOMMON_SUPPORT=y
CONFIG_SPL_LIBGENERIC_SUPPORT=y
CONFIG_SPL_SYS_MALLOC=y
CONFIG_SPL_FRAMEWORK=y
CONFIG_SPL_FOOTPRINT_LIMIT=y
CONFIG_SPL_MAX_FOOTPRINT=0x3800

CONFIG_IDENT_STRING=" for iTOP-4412"
CONFIG_DISTRO_DEFAULTS=y
CONFIG_BOARD_LATE_INIT=y
CONFIG_SYS_PBSIZE=1024
CONFIG_SYS_CONSOLE_IS_IN_ENV=y
CONFIG_SYS_CONSOLE_INFO_QUIET=y
CONFIG_SYS_PROMPT="iTOP-4412 # "
CONFIG_CMD_DFU=y
CONFIG_CMD_MBR=y
CONFIG_CMD_GPT=y
CONFIG_CMD_UUID=y
CONFIG_CMD_MMC=y
CONFIG_CMD_USB=y
CONFIG_CMD_CACHE=y
CONFIG_CMD_PMIC=y
CONFIG_CMD_REGULATOR=y

CONFIG_CMD_NET=y
CONFIG_CMD_DHCP=y
CONFIG_CMD_TFTPBOOT=y
CONFIG_CMD_PING=y

CONFIG_DOS_PARTITION=y

CONFIG_OF_CONTROL=y
CONFIG_ENV_OVERWRITE=y
CONFIG_ENV_RELOC_GD_ENV_ADDR=y
CONFIG_DFU_MMC=y
CONFIG_SYS_DFU_DATA_BUF_SIZE=0x2000000
CONFIG_MMC_DW=y
CONFIG_MMC_DW_EXYNOS=y
CONFIG_MMC_SDHCI=y
CONFIG_MMC_SDHCI_SDMA=y
CONFIG_MMC_SDHCI_S5P=y

CONFIG_DM_I2C=y
CONFIG_SYS_I2C_S3C24X0=y
CONFIG_DM_PMIC=y
CONFIG_PMIC_S5M8767=y
CONFIG_DM_REGULATOR=y
CONFIG_DM_REGULATOR_FIXED=y
CONFIG_REGULATOR_S5M8767=y
CONFIG_PWRSEQ=y
CONFIG_MMC_PWRSEQ=y
CONFIG_CMD_I2C=y
CONFIG_CMD_GPIO=y
CONFIG_GPIO_HOG=y

CONFIG_CMD_MEMTEST=y

CONFIG_USB=y
CONFIG_USB_HOST=y
CONFIG_USB_EHCI_HCD=y
CONFIG_USB_EHCI_EXYNOS=y
CONFIG_DM_USB=y
CONFIG_USB_GADGET=y
CONFIG_USB_GADGET_MANUFACTURER="Samsung"
CONFIG_USB_GADGET_VENDOR_NUM=0x18D1
CONFIG_USB_GADGET_PRODUCT_NUM=0x4E30
CONFIG_USB_GADGET_DWC2_OTG=y
CONFIG_USB_GADGET_DWC2_OTG_PHY=y
CONFIG_USB_GADGET_DOWNLOAD=y

CONFIG_USB_HOST_ETHER=y
CONFIG_USB_ETHER_DM9601=y

CONFIG_USB_ONBOARD_HUB=y

CONFIG_USB_FUNCTION_FASTBOOT=y
CONFIG_FASTBOOT_BUF_ADDR=0x48000000
CONFIG_FASTBOOT_BUF_SIZE=0x20000000
CONFIG_FASTBOOT_FLASH=y
CONFIG_FASTBOOT_FLASH_MMC=y
CONFIG_FASTBOOT_FLASH_MMC_DEV=0
CONFIG_FASTBOOT_MMC_BOOT_SUPPORT=y
CONFIG_FASTBOOT_MMC_USER_SUPPORT=y
```
